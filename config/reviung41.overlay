/ {
    chosen {
        zmk,kscan = &kscan_custom;
    };

    kscan_custom: kscan_custom {
        compatible = "zmk,kscan-gpio-demux";
        unselected-gpios-state = "high";
        label = "KSCAN_CUSTOM";
        polling-interval-msec = <25>;

      /* ACTIVE_HIGH를 ACTIVE_LOW로 변경하여 디코더의 출력 방식과 맞춥니다 */
        output-gpios
            = <&gpio0 31 GPIO_ACTIVE_LOW> // A0
            , <&gpio0 29 GPIO_ACTIVE_LOW> // A1
            , <&gpio0 2  GPIO_ACTIVE_LOW> // A2
            ;

        /* 컬럼 설정 (이건 그대로 두시면 됩니다) */
        input-gpios
            = <&gpio1 15 (GPIO_ACTIVE_LOW | GPIO_PULL_UP)>
            , <&gpio1 13 (GPIO_ACTIVE_LOW | GPIO_PULL_UP)>
            , <&gpio1 11 (GPIO_ACTIVE_LOW | GPIO_PULL_UP)>
            , <&gpio0 10 (GPIO_ACTIVE_LOW | GPIO_PULL_UP)>
            , <&gpio0 9  (GPIO_ACTIVE_LOW | GPIO_PULL_UP)>
            , <&gpio0 6  (GPIO_ACTIVE_LOW | GPIO_PULL_UP)>
            , <&gpio0 8  (GPIO_ACTIVE_LOW | GPIO_PULL_UP)>
            , <&gpio0 17 (GPIO_ACTIVE_LOW | GPIO_PULL_UP)>
            , <&gpio0 20 (GPIO_ACTIVE_LOW | GPIO_PULL_UP)>
            , <&gpio0 22 (GPIO_ACTIVE_LOW | GPIO_PULL_UP)>
            , <&gpio0 24 (GPIO_ACTIVE_LOW | GPIO_PULL_UP)>
            , <&gpio1 0  (GPIO_ACTIVE_LOW | GPIO_PULL_UP)>
            , <&gpio0 11 (GPIO_ACTIVE_LOW | GPIO_PULL_UP)>
            , <&gpio1 4  (GPIO_ACTIVE_LOW | GPIO_PULL_UP)>
            , <&gpio1 6  (GPIO_ACTIVE_LOW | GPIO_PULL_UP)>
            , <&gpio1 7  (GPIO_ACTIVE_LOW | GPIO_PULL_UP)>
            , <&gpio1 2  (GPIO_ACTIVE_LOW | GPIO_PULL_UP)>
            , <&gpio1 1  (GPIO_ACTIVE_LOW | GPIO_PULL_UP)>
            ;
    };
};
